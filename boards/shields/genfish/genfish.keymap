#include <behaviors.dtsi>
#include <dt-bindings/zmk/keys.h>
#include <dt-bindings/zmk/bt.h>
#include <dt-bindings/zmk/outputs.h>
#include <dt-bindings/zmk/pointing.h>
#include <input/processors.dtsi>


/{
    keymap {
        compatible = "zmk,keymap";
        layer_def:layer_def{};
    };
};

&layer_def {
    bindings = <&kp A>;
};
